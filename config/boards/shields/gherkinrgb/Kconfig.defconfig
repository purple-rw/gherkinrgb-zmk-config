## config/boards/shields/gherkinrgb/Kconfig.defconfig
```kconfig
# Copyright (c) 2022 purple-rw
# SPDX-License-Identifier: MIT

if SHIELD_GHERKINRGB

config ZMK_KEYBOARD_NAME
    default "Gherkin RGB"

endif
```

## config/boards/shields/gherkinrgb/Kconfig.shield
```kconfig
# Copyright (c) 2022 purple-rw
# SPDX-License-Identifier: MIT

config SHIELD_GHERKINRGB
    def_bool $(shields_list_contains,gherkinrgb)
```
